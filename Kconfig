## lib/ranging/Kconfig
```kconfig
# Copyright (c) 2021, Legrand North America, LLC.
# SPDX-License-Identifier: Apache-2.0

config SYNCHROFLY_RANGING
	bool "Enable ranging methods (TWR/TDOA)"
	help
	  Enable ranging methods


config DECA_RANGING_DIGEST_HEAP_SIZE
	int "Digest heap size in bytes"
	default 16384
	range 256 65536
	help
	  Size of the heap used for ranging digest allocation. This heap stores
	  frame containers and frame data during ranging operations. Increase if
	  you get allocation failures with large ranging rounds.

	  Recommended minimum: 16KB for typical MTM operations
	  Each frame requires approximately 500 bytes (container + frame data)

config MM_RANGING_TIME_SERIES_HEAP_SIZE
	int "Time series heap size in bytes"
	default 8192
	range 256 32768
	help
	  Size of the heap used for time series storage allocation. This heap stores
	  time series data structures and sample buffers for mm-accurate ranging.

	  Each time series requires approximately:
	  - Structure overhead: ~32 bytes
	  - Sample buffer: series_size * 8 bytes

	  For typical usage with 4-6 node pairs and 3-4 series per pair:
	  - Conservative: 4KB (small networks)
	  - Recommended: 8KB (typical networks)
	  - Large networks: 16KB+

config MM_RANGING_FILTER_CONTEXT_SIZE
	int "Phase filter context size in bytes"
	default 768
	range 256 2048
	help
	  Memory allocation size per phase filter context for millimeter-accurate ranging.
	  Each filter context needs space for its state and circular buffers.

	  For moving average filters with window size N:
	  - Context struct: ~48 bytes
	  - Sample buffer: N * 8 bytes
	  - Unwrapped phase buffer: N * 8 bytes
	  Total needed: 48 + 16*N bytes

	  For Savitzky-Golay filters with window size N:
	  - Context struct: ~60 bytes
	  - 5 sample buffers: 5 * N * 8 bytes
	  - 2 double buffers: 2 * N * 8 bytes
	  Total needed: 60 + 56*N bytes

	  Default 768 bytes supports Savitzky-Golay with window size ~13.

config MM_RANGING_TIME_SERIES_SIZE
	int "Time series history size for ambiguity resolution"
	default 15
	range 5 64
	help
	  Number of measurements stored in time series for ambiguity resolution
	  in dual-channel millimeter-accurate ranging. Each series stores historical
	  data for TWR distance, phase measurements (both channels), and delta-phi.

	  Larger values provide better filtering and trend analysis but consume
	  more memory. Each measurement point requires ~32 bytes across all series.

	  Memory usage per node pair: ~4 * size * 32 bytes = ~128 * size bytes
	  Default 15: ~1.9KB per node pair
	  Max 64: ~8.2KB per node pair

config MM_RANGING_ENABLE_RESIDUAL_PHASE_FILTERING
	bool "Enable residual phase filtering in fine phase computation"
	default n
	help
	  Enable filtering of residual phase in compute_fine_phase_mm function.
	  When enabled, residual phase values are stored in time series and
	  filtered using the configured filter type (moving average or Savitzky-Golay).

	  This allows selective filtering of the residual phase component used
	  in fine phase recovery.

	  When disabled, raw unfiltered residual phase is used directly.

	  Disable this to test raw residual phase quality or for debugging.

config MM_RANGING_ENABLE_FINE_PHASE_FILTERING
	bool "Enable filtering for recovered fine phase measurements"
	default n
	help
	  Enable smoothing of recovered fine phase values using a separate
	  unwrapped time series per node pair and channel. This allows
	  Savitzky-Golay or moving-average filters to operate on continuous
	  phase evolution before the result is wrapped back into [0, 2π].

	  When disabled, raw fine phase measurements are propagated without
	  additional smoothing.

config MM_RANGING_FILTER_WINDOW_SIZE
	int "Default phase filter window size"
	default 10
	range 3 100
	help
	  Default window size for phase filtering in millimeter-accurate ranging.
	  Larger windows provide better noise reduction but require more memory
	  and introduce more latency.

	  IMPORTANT: Must be <= CONFIG_MM_RANGING_TIME_SERIES_SIZE to avoid
	  accessing more data than available in history buffer.

	  Must be compatible with MM_RANGING_FILTER_CONTEXT_SIZE:
	  Required context size >= 48 + 16 * window_size

config MM_RANGING_RESIDUAL_PHASE_FILTER_WINDOW_SIZE
	int "Residual phase filter window size"
	depends on MM_RANGING_ENABLE_RESIDUAL_PHASE_FILTERING
	default 10
	range 3 100
	help
	  Window size for residual phase filtering in compute_fine_phase_mm.
	  This is independent of the main MM_RANGING_FILTER_WINDOW_SIZE setting.

	  Larger windows provide better noise reduction but require more memory
	  and introduce more latency.

	  IMPORTANT: Must be <= CONFIG_MM_RANGING_TIME_SERIES_SIZE to avoid
	  accessing more data than available in history buffer.

config MM_RANGING_USE_SAVITZKY_GOLAY
	bool "Use Savitzky-Golay filter for phase measurements"
	default n
	help
	  Enable Savitzky-Golay filter for phase measurements instead of
	  simple moving average. Savitzky-Golay provides better smoothing
	  while preserving important signal features, matching the Python
	  reference implementation (scipy.signal.savgol_filter).

	  When enabled, phase measurements (fine_phase_ch5, fine_phase_ch3,
	  coarse_phase) will use Savitzky-Golay filtering, while other
	  measurements (TWR TOF, CFO) continue using moving average.

if MM_RANGING_USE_SAVITZKY_GOLAY

config SAVITZKY_GOLAY_WINDOW_SIZE
	int "Savitzky-Golay filter window size"
	default 10
	range 5 13
	help
	  Window size for Savitzky-Golay filter. Must be odd number.

	  Larger windows provide more smoothing but increase latency.
	  Must not exceed MAX_WINDOW (13) from external library.

config SAVITZKY_GOLAY_POLY_ORDER
	int "Savitzky-Golay polynomial order"
	default 3
	range 2 6
	help
	  Polynomial order for Savitzky-Golay filter fitting.
	  Default 3 matches Python reference implementation.

	  Higher orders can better preserve signal features but may
	  introduce artifacts. Must be less than window size.

endif # MM_RANGING_USE_SAVITZKY_GOLAY

choice MM_RANGING_ALGORITHM_TYPE
	prompt "Time series ambiguity resolution algorithm"
	default MM_RANGING_USE_MATLAB_ALGORITHM
	help
	  Choose between different time series-based ambiguity resolution algorithms.

	  The MATLAB algorithm uses the approach from the reference MATLAB script with
	  error correction and lambda_new calculation.

	  The Paper algorithm uses the original paper's approach with time series smoothing
	  for noise reduction while maintaining the proven mathematical foundation.

	config MM_RANGING_USE_MATLAB_ALGORITHM
		bool "MATLAB-style algorithm (current default)"
		help
		  Use the MATLAB-based algorithm (resolve_ambiguity_dual_channel_ts).
		  This is the current default implementation.

endchoice

config SYNCHROFLY_RANGING_SOMETHING
	int "placeholder"
	default 0
	help
	  This option primarily exists as an example of a library Kconfig
	  setting.

	  This option specifies the value for custom_get_value() to return
	  when the input parameter is zero. (Otherwise the function returns the
	  input parameter value.)

# MM ranging module logging configuration
module = TWR_MM
module-str = twr_mm
source "subsys/logging/Kconfig.template.log_config"

# Phase recovery module logging configuration
module = PHASE_RECOVERY
module-str = phase_recovery
source "subsys/logging/Kconfig.template.log_config"

# Ambiguity resolution module logging configuration
module = AMBIGUITY_RESOLUTION
module-str = ambiguity_resolution
source "subsys/logging/Kconfig.template.log_config"
```

## lib/scheduling/lower/Kconfig
```kconfig
# Copyright (c) 2021, Legrand North America, LLC.
# SPDX-License-Identifier: Apache-2.0

config SYNCHROFLY_SCHEDULING_MTM_MAX_SLOTS
	int "max slots for a MTM schedule"
	default 100
	help
	  This option primarily exists as an example of a library Kconfig
	  setting.

	  This option specifies the value for custom_get_value() to return
	  when the input parameter is zero. (Otherwise the function returns the
	  input parameter value.)

config CONTENTION_PARTICIPATION_PROBABILITY
	int "Contention participation probability (%)"
	default 80
	range 0 100
	help
	  Probability (in percentage) that a node will participate in ranging
	  during contention-based MTM blocks. This controls network load and
	  interference levels. 100% means all nodes always participate,
	  while lower values create random participation patterns.

config SYNCHROFLY_SCHEDULING_SLOT_PADDING_US
	int "Slot duration padding time in microseconds"
	default 50
	range 10 1000
	help
	  Padding time added to calculated slot duration to compensate for
	  unaccounted timing factors in the ideal slot calculation. The need
	  for significant padding (e.g., 200us) indicates missing components
	  in the slot duration model such as radio state transitions, interrupt
	  latencies, or processing delays. Higher values ensure reliable
	  operation but reduce throughput.
```

## lib/scheduling/upper/Kconfig
```kconfig
# Copyright (c) 2021, Legrand North America, LLC.
# SPDX-License-Identifier: Apache-2.0

config SYNCHROFLY_BLOCK_SCHEDULER_WARMUP_MS
	int "Warmup duration for scheduler in milliseconds"
	default 10000
	help
	  Warmup duration in milliseconds. During warmup, only sync blocks
	  (Glossy or Butler) run to bootstrap the network. All nodes transition
	  to normal superframe execution at the same reference-time boundary.

config SYNCHROFLY_SUPERFRAME_MAX_SLOTS
	int "Maximum amount of slots contained in superframe"
	default 70
	help
           This setting specifies the amount of slots contained in the superframe.
           A slot may contain a block for execution.
```

## lib/stats/Kconfig
```kconfig
config FIRMWARE_STATS
	bool "Enable on-demand firmware statistics collection"
	default n
	help
	  Central statistics module that tracks counters on demand.
	  Stats are activated via BLE subscription and use atomic
	  operations for ISR-safe updates.

if FIRMWARE_STATS

config FIRMWARE_STATS_MAX_SLOTS
	int "Maximum simultaneous tracked statistics"
	default 8
	range 1 32
	help
	  Each slot consumes 16 bytes of static RAM. The default of 8
	  allows tracking e.g. 3 global counters + 5 per-neighbor stats.

endif # FIRMWARE_STATS
```

## lib/status/Kconfig
```kconfig
# Copyright (c) 2025 SynchroFly Project
# SPDX-License-Identifier: Apache-2.0

# Status LED module logging configuration
module = SYNCHROFLY_STATUS
module-str = synchrofly_status
source "subsys/logging/Kconfig.template.log_config"
```

## lib/swarm_ranging/Kconfig
```kconfig
# SwarmRanging library Kconfig

config SYNCHROFLY_SWARM_RANGING
	bool "SwarmRanging protocol library"
	default n
	help
	  Enable the SwarmRanging protocol library. This provides the
	  SEU-NetSI swarm ranging implementation as a shared library
	  that can be used by multiple applications.

if SYNCHROFLY_SWARM_RANGING

config SWARM_RANGING_PERIOD_MS
	int "Default ranging period in milliseconds"
	default 200
	range 50 1000
	help
	  Default period for sending ranging messages.

config SWARM_RANGING_TABLE_SIZE
	int "Maximum ranging table size"
	default 20
	range 5 32
	help
	  Maximum number of neighbors to track in ranging table.

config SWARM_NEIGHBOR_ADDRESS_MAX
	int "Maximum neighbor address"
	default 32
	range 8 64
	help
	  Maximum address value for neighbors. Used for bitset sizing.

config SWARM_RANGING_RX_QUEUE_SIZE
	int "Ranging RX message queue size"
	default 5
	range 2 10
	help
	  Size of the queue for incoming ranging messages.

config SWARM_RANGING_TX_STACK_SIZE
	int "Ranging TX thread stack size"
	default 1024
	range 512 2048
	help
	  Stack size for ranging TX thread in bytes.

config SWARM_RANGING_RX_STACK_SIZE
	int "Ranging RX thread stack size"
	default 1024
	range 512 2048
	help
	  Stack size for ranging RX thread in bytes.

config SWARM_RANGING_THREAD_PRIORITY
	int "Ranging thread priority"
	default 5
	range 1 15
	help
	  Priority for ranging TX and RX threads.

config SWARM_UWB_RX_STACK_SIZE
	int "UWB RX thread stack size"
	default 2048
	range 512 4096
	help
	  Stack size for UWB hardware RX thread in bytes.

config SWARM_ENABLE_BUS_BOARDING
	bool "Enable bus boarding scheme"
	default n
	help
	  Enable bus boarding scheme for ranging message scheduling.

config SWARM_ENABLE_DYNAMIC_PERIOD
	bool "Enable dynamic ranging period"
	default n
	help
	  Enable dynamic adjustment of ranging period based on
	  distance and velocity.

endif # SYNCHROFLY_SWARM_RANGING
```

## lib/system/Kconfig
```kconfig
choice SYNCHROFLY_NODE_ID_SOURCE
	prompt "Node ID source"
	default SYNCHROFLY_NODE_ID_FROM_HWINFO

config SYNCHROFLY_NODE_ID_FROM_HWINFO
	bool "Use hardware info for node ID"
	help
	  Derive node ID from hardware information.

config SYNCHROFLY_NODE_ID_FROM_TABLE
	bool "Use predefined table for node ID"
	help
	  Use a statically configured table to determine node ID.

config SYNCHROFLY_NODE_ID_FROM_SETTINGS
	bool "Read from settings subsystem"
	help
	  Use settings subsystem to determine node ID.
endchoice

choice SYNCHROFLY_ROOT_NODE_SOURCE
	prompt "Root node designation source"
	default SYNCHROFLY_ROOT_NODE_FROM_STATIC

config SYNCHROFLY_ROOT_NODE_FROM_STATIC
	bool "Use static configuration"
	help
	  Determine root node status by comparing node address with
	  CONFIG_GLOSSY_TX_FLOOD_START_NODE_ID at compile time.
	  Useful for automated testbed deployments.

config SYNCHROFLY_ROOT_NODE_FROM_SETTINGS
	bool "Read from settings subsystem"
	help
	  Read root node status from settings subsystem, allowing
	  runtime configuration via GATT or shell commands.
	  Useful for field deployments where network topology is
	  configured dynamically.
endchoice

config SYNCHROFLY_BLOCK_HEAP_SIZE
	int "Block heap size in bytes"
	default 6144
	help
	  Dedicated heap for transient per-block allocations (digest,
	  schedule, measurements, swarm ranging). Separated from the
	  system heap to prevent fragmentation from interleaving
	  short-lived block allocations with long-lived time series.

config SYNCHROFLY_RADIO_ARBITER
	bool "Radio arbiter for async protocol coexistence"
	default n
	help
	  Enable the radio arbiter module which manages radio ownership
	  between the synchronous superframe scheduler and asynchronous
	  background protocols. When enabled, superframe blocks implicitly
	  claim the radio, and a baseline block can release it for
	  background protocol use.
```

## lib/timesync/Kconfig
```kconfig
# Copyright (c) 2021, Legrand North America, LLC.
# SPDX-License-Identifier: Apache-2.0

config SYNCHROFLY_TIMESYNC_WORK_QUEUE_STACK_SIZE
	int "Time sync work queue stack size"
	default 2048
	help
	  Stack size for the time synchronization work queue thread.
	  Can be reduced to 1024 on memory-constrained devices.

# Time synchronization module logging configuration
module = TIME_SYNCHRONIZATION
module-str = time_synchronization
source "subsys/logging/Kconfig.template.log_config"

# Cyclic timeutil module logging configuration
module = CYCLIC_TIMEUTIL
module-str = cyclic_timeutil
source "subsys/logging/Kconfig.template.log_config"
```
