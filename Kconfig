## Kconfig
```kconfig
menu "Tracing"

config SYNCHROFLY_TRACING_SYSTEMVIEW
    bool "Enable SEGGER SystemView tracing support"
    depends on SYNCHROFLY
    depends on HAS_SEGGER_RTT
    select TRACING
    help
      Enable Zephyr's SEGGER SystemView tracing backend so the firmware can
      publish runtime timing information over RTT. When enabled, SystemView can
      attach through SEGGER RTT to visualise task scheduling and timing as
      documented in the Zephyr tracing guide.

config SEGGER_SYSVIEW_RTT_CHANNEL
    default 2 if SYNCHROFLY_TRACING_SYSTEMVIEW

config SYNCHROFLY_TRACING_SYSTEMVIEW_AUTOSTART
    bool "Automatically start SystemView session at boot"
    default y
    depends on SYNCHROFLY_TRACING_SYSTEMVIEW
    help
      Start SystemView recording automatically during application
      initialisation so traces are captured without needing to trigger a start
      command from the host tool.

endmenu

menuconfig MTM_RANGING_SUBSYSTEM
        bool "MTM_RANGING_SUBSYSTEM"
        default y
        help
          Enable mtm ranging subsystem

if MTM_RANGING_SUBSYSTEM

module = MTM_RANGING_SUBSYSTEM
module-str = mtm_ranging_subsystem
source "subsys/logging/Kconfig.template.log_config"

config NUM_NODES
    int "Number of nodes"
    default 2

config RANGING_RADIO_SLEEP
    bool "Ranging radio sleep"
    default n

config START_DISABLED
    bool "Start in disabled state"
    default n


config GLOSSY_TX_FLOOD_START_NODE_ID
    hex "Glossy TX flood start node ID"
    default 0x00


config DEFAULT_ROUND_DURATION
    int "default duration of global event scheduling"
    default 25

config TIME_SYNCHRONIZATION_THREAD_PRIORITY
    int "Time synchronization thread priority"
    default -12
    help
      Priority of the time synchronization work queue thread.
      Must be higher (more negative) than ALL BLE thread priorities:
        - BT RX pri:    K_PRIO_COOP(6) = -10
        - HCI TX:       K_PRIO_COOP(7) = -9
        - BT RX WQ:     K_PRIO_COOP(8) = -8 (GATT callbacks here)
        - BT Conn TX:   K_PRIO_COOP(8) = -8
      Setting to -12 ensures time sync has highest priority.

config USE_DOUBLE_SIDED
    bool "Use double sided two way ranging"
    default y

config DWT_MTM_CIR_BUFFER_SIZE
    int "amount of buffer space for storing CIR data"
    default 200
endif
```

## lib/Kconfig
```kconfig
menu "Zephyr UWB Libraries"

config SYNCHROFLY
	bool "enable synchrofly libraries"
	default false
	help
          If true build Synchrofly libraries.

rsource "timesync/Kconfig"
rsource "scheduling/Kconfig"
rsource "localization/Kconfig"
rsource "ranging/Kconfig"
rsource "logging/Kconfig"
rsource "system/Kconfig"
rsource "management/Kconfig"
rsource "blocks/Kconfig"
rsource "communication/Kconfig"
rsource "bluetooth/Kconfig"
rsource "node_table/Kconfig"
rsource "crazyflie/Kconfig"
rsource "swarm_ranging/Kconfig"
rsource "bias_correction/Kconfig"
rsource "stats/Kconfig"

endmenu
```

## lib/bias_correction/Kconfig
```kconfig
config POLY_CORRECTION_MAX_NODES
	int "Maximum per-node polynomial corrections"
	default 20
	range 0 40
	help
	  Maximum number of per-node polynomial correction entries
	  that can be stored simultaneously. Each entry costs ~22 bytes
	  of static RAM.
```

## lib/blocks/Kconfig
```kconfig
# Copyright (c) 2021, Legrand North America, LLC.
# SPDX-License-Identifier: Apache-2.0

config SYNCHROFLY_BLOCK_LS_POSITION
	bool "Least Squares Position Block"
	depends on MAC_QUEUE
	default y if CRAZYFLIE
	default n
	help
	  Enable the Least Squares Position block which computes node position
	  from anchor distances after ranging. Requires MAC_QUEUE for payload
	  exchange. Uses approximately 1KB additional RAM for queue buffers.

	  When CONFIG_CRAZYFLIE is enabled, this block also forwards the
	  computed position to the Crazyflie STM32 via SPI.

config SYNCHROFLY_BLOCK_PF_POSITION
	bool "Particle Filter Position Block"
	depends on MAC_QUEUE
	default n
	help
	  Enable the Particle Filter Position block which computes node position
	  using sequential Monte Carlo methods. More robust to non-Gaussian noise
	  than least squares but requires more computation and memory.

	  Anchor nodes (STATIC mode) use exactly 1 particle representing their
	  known position. Mobile nodes use the configurable particle count below.

config SYNCHROFLY_PF_MAX_PARTICLES
	int "Maximum particles for particle filter (mobile nodes)"
	depends on SYNCHROFLY_BLOCK_PF_POSITION
	default 50
	range 10 200
	help
	  Maximum number of particles for mobile nodes running the particle filter.
	  Anchor nodes always use exactly 1 particle regardless of this setting.
	  More particles improve accuracy but increase memory (16 bytes/particle)
	  and computation time. Default 50 particles uses 800 bytes.

config SYNCHROFLY_BLOCK_SWARM_RANGING
	bool "Swarm ranging protocol block"
	default n
	help
	  Enable the swarm ranging block which releases the radio for
	  asynchronous swarm ranging protocol use during its time slot.
	  Requires the radio arbiter module for radio ownership management.

config SYNCHROFLY_BLOCK_MULOC
	bool "MULoc anchor overhearing block"
	default n
	help
	  Enable the MULoc block which implements the anchor overhearing
	  protocol for mm-level UWB localization. Anchors broadcast in
	  round-robin and embed CIR/phase/timestamp data from overheard
	  transmissions. Tags passively collect all anchor measurements.

	  Raw measurement data is streamed via BLE GATT notifications
	  for offline processing (e.g., with MATLAB).

config SYNCHROFLY_BLOCK_BUTLER
	bool "Butler distributed time synchronization block"
	default n
	help
	  Enable Butler: distributed time synchronization via probabilistic
	  flooding. No single initiator required. Multiple nodes propose
	  reference times, converge on the earliest. Uses simple offset
	  (no skew estimation). Sync resets each round.

config SYNCHROFLY_BLOCK_CIR_READ
	bool "CIR Read block"
	default n
	help
	  Enable the CIR Read block for Channel Impulse Response captures.
	  Each node is configured as sender (transmit probe) or receiver
	  (listen and read DW1000 accumulator). Timing is derived from
	  glossy time synchronization. CIR data is transferred via BLE
	  notifications. The CIR buffer is heap-allocated per capture.

config SYNCHROFLY_BLOCK_SOMETHING
	int "placeholder"
	default 0
	help
	  This option primarily exists as an example of a library Kconfig
	  setting.

	  This option specifies the value for custom_get_value() to return
	  when the input parameter is zero. (Otherwise the function returns the
	  input parameter value.)
```

## lib/bluetooth/Kconfig
```kconfig
# Bluetooth LE Peripheral Library Configuration

config SYNCHROFLY_BT
	bool "Enable SynchroFly Bluetooth LE peripheral"
	depends on BT
	select BT_PERIPHERAL
	select BT_GATT_DYNAMIC_DB
	default n
	help
	  Enable Bluetooth LE peripheral functionality for SynchroFly devices.
	  Provides automatic advertising, connection management, status LED control,
	  and support for MCUmgr DFU when enabled.

if SYNCHROFLY_BT

config SYNCHROFLY_BT_DEVICE_NAME_PREFIX
	string "Device name prefix"
	default "SynchroFly"
	help
	  Prefix for BLE device name. The full name will be
	  "<prefix>-XXXX" where XXXX is the node ID
	  (IoT-LAB compatible UID) in hexadecimal.

config SYNCHROFLY_BT_STATUS_LED
	bool "Enable Bluetooth status LED"
	depends on GPIO
	default y
	help
	  Enable LED indication for Bluetooth status:
	  - OFF: Bluetooth disabled
	  - Blinking (1Hz): Advertising, waiting for connection
	  - ON (solid): Connected

config SYNCHROFLY_BT_NODE_CONFIG_SERVICE
	bool "Enable node configuration GATT service"
	depends on SETTINGS
	default y
	help
	  Enable GATT service for remote configuration of node parameters:
	  - Position (x, y, z coordinates in meters)
	  - Node ID
	  - Node mode (disabled/active/passive)
	  
	  All values persist to settings and survive reboots.

config SYNCHROFLY_BT_NEIGHBOR_TABLE_SERVICE
	bool "Enable neighbor table GATT service"
	depends on NODE_TABLE
	default y if NODE_TABLE
	help
	  Enable GATT service for reading neighbor table information:
	  - Neighbor count
	  - Neighbor list with distance, age, hop count, RSSI
	  
	  Supports notifications to push updates to connected clients.

config SYNCHROFLY_BT_NETWORK_SETTINGS_SERVICE
	bool "Enable network settings GATT service"
	depends on SETTINGS
	default y
	help
	  Enable GATT service for remote configuration of network parameters:
	  - Scheduling scheme (Basic/Hashed/Contention)
	  - Ranging round parameters (slots per phase, phases)
	  - Superframe slots
	  - Glossy parameters (guard, max depth, TX delay)
	  - Scheduler slot duration
	  
	  All values persist to settings and survive reboots.

config SYNCHROFLY_BT_FILTER_CONFIG_CHARS
	bool "Enable distance filter configuration BLE characteristics"
	depends on SYNCHROFLY_BT_NETWORK_SETTINGS_SERVICE
	depends on NODE_TABLE_DISTANCE_SERIES_ENABLED
	default y
	help
	  Add BLE characteristics for runtime configuration of distance
	  filter strategy, window size, poly order, and series capacity.
	  Disabled by default on nRF52832 (DWM1001) to save ~120 bytes RAM.
	  On platforms with more RAM (UWBDeck/nRF52840), enabled by default.

config SYNCHROFLY_BT_UWB_RADIO_SERVICE
	bool "Enable UWB radio settings GATT service"
	default y
	help
	  Enable GATT service for remote configuration of UWB radio parameters:
	  - TX antenna delay
	  - RX antenna delay
	  
	  Antenna delays are in timestamp units (~15.65 ps per unit).

config SYNCHROFLY_BT_SUPERFRAME_CONFIG_SERVICE
	bool "Enable superframe configuration GATT service"
	depends on SETTINGS
	default y
	help
	  Enable GATT service for runtime configuration of superframe structure:
	  - Block count (number of blocks in superframe)
	  - Block configurations (type-specific settings per block)
	  - Apply changes (rebuild and restart superframe)
	  
	  Supports reading/writing individual blocks or full configuration.
	  Changes persist to NVS settings and survive reboots.

config SYNCHROFLY_BT_IDENTIFICATION_SERVICE
	bool "Enable device identification GATT service"
	default y
	help
	  Enable GATT service for triggering visual device identification.
	  Writing to the trigger characteristic causes the status LED to
	  blink rapidly for 2 seconds, helping users identify which physical
	  device corresponds to a BLE address.

config SYNCHROFLY_BT_CRTP_SERVICE
	bool "Enable CRTP bridge GATT service"
	depends on CRAZYFLIE
	default y if CRAZYFLIE
	help
	  Enable GATT service for sending CRTP packets to the Crazyflie.
	  Packets written to the TX characteristic are forwarded via the
	  SPI HCI protocol to the Crazyflie STM32 and injected into its
	  CRTP router. This enables direct control of the Crazyflie via
	  BLE, bypassing the nRF52 radio.
	  
	  Requires CONFIG_CRAZYFLIE to be enabled (Crazyflie connector).
	  
	  Service UUID: 63727470-0000-0000-0000-000000000000 ("crtp")
	  TX Char UUID: 63727470-0000-0000-0000-000000000001

module = CRTP_SERVICE
module-str = CRTP Bridge Service
source "subsys/logging/Kconfig.template.log_config"

config SYNCHROFLY_BT_AB_TESTING_SERVICE
	bool "Enable A/B testing GATT service"
	default y
	help
	  Generic key-value BLE service for runtime A/B testing of firmware
	  algorithm variants.  Write an index to select a toggle, then
	  read/write its uint8 value.  All toggles default to 0 (variant A).

config SYNCHROFLY_BT_SYSTEM_PROFILING_SERVICE
	bool "Enable system profiling GATT service"
	depends on THREAD_STACK_INFO
	depends on SYS_HEAP_RUNTIME_STATS
	default y
	help
	  Enable GATT service exposing runtime system profiling data:
	  - Heap usage (free, allocated, peak bytes)
	  - Per-thread stack usage (name, total size, high watermark)

	  Requires CONFIG_THREAD_STACK_INFO and CONFIG_SYS_HEAP_RUNTIME_STATS.

config SYNCHROFLY_BT_SYSTEM_CONTROL_SERVICE
	bool "Enable system control GATT service"
	default y
	select REBOOT
	help
	  Enable GATT service for remote system control via BLE.
	  Writing to the reset characteristic triggers a soft reboot
	  after a short delay (allowing the BLE write response to be sent).

config SYNCHROFLY_BT_FIRMWARE_STATS_SERVICE
	bool "Enable firmware statistics GATT service"
	depends on FIRMWARE_STATS
	default y if FIRMWARE_STATS
	help
	  BLE service for subscribing to and reading on-demand firmware
	  statistics. Allows a BLE client to activate stat counters,
	  read their values, and receive change-driven notifications.

config SYNCHROFLY_BT_INIT_PRIORITY
	int "Bluetooth initialization priority"
	default 91
	help
	  Priority for Bluetooth initialization. Must be higher than
	  CONFIG_APPLICATION_INIT_PRIORITY (90) to ensure MCUmgr
	  handlers are registered before advertising starts.

endif # SYNCHROFLY_BT
```

## lib/communication/Kconfig
```kconfig
# SPDX-License-Identifier: Apache-2.0

menuconfig MAC_QUEUE
	bool "MAC Frame Queue Support"
	help
	  Enable MAC-level frame queueing abstraction for SynchroFly.
	  Provides dual TX/RX queues for exchanging IEEE 802.15.4 frames
	  between blocks and applications.

if MAC_QUEUE

config MAC_QUEUE_TX_DEPTH
	int "TX queue depth"
	default 4
	help
	  Maximum number of frames that can be queued for transmission.
	  Used for MAC protocols and applications to enqueue frames
	  that should be transmitted during the next communication opportunity.

config MAC_QUEUE_RX_DEPTH
	int "RX queue depth"
	default 8
	help
	  Maximum number of received frames that can be buffered.
	  Used to store frames received from the network that applications
	  can consume asynchronously.

config MAC_QUEUE_ENABLE_STATS
	bool "Enable queue statistics"
	default y
	help
	  Enable collection of queue statistics such as frame counts,
	  drops, and queue utilization. Useful for debugging and
	  performance monitoring.

config MAC_QUEUE_ENABLE_SHELL
	bool "Enable shell commands"
	depends on SHELL
	default y if SHELL
	help
	  Enable shell commands for inspecting queue state and
	  statistics. Provides commands to view pending frames
	  and clear queues.

endif # MAC_QUEUE
```

## lib/crazyflie/Kconfig
```kconfig
config CRAZYFLIE
	bool "Whether to enable crazyflie connector integration"
        default false
	depends on $(dt_compat_enabled,synchrofly-hci-slave)
	help
          build with connector utilities. Requires synchrofly-hci-slave device in DT.

config CRAZYFLIE_CONNECTOR_MEASUREMENTS_BUFFER_SIZE
	int "Maximum amount of measurements which can be allocated"
        default 20
	help
	  defined the maximum amount of measurements which a SPI transfer from Synchrofly
          to the Crazyflie might contain.

module = SPI_CONNECTOR
module-str = SPI Connector (Crazyflie HCI)
source "subsys/logging/Kconfig.template.log_config"
```

## lib/localization/Kconfig
```kconfig
# Copyright (c) 2021, Legrand North America, LLC.
# SPDX-License-Identifier: Apache-2.0

config SYNCHROFLY_LOCALIZATION
	bool "Enable onboard localization methods"
	help
	  Enable onboard localization


config SYNCHROFLY_LOCALIZATION_SOMETHING
	int "placeholder"
	default 0
	help
	  This option primarily exists as an example of a library Kconfig
	  setting.

	  This option specifies the value for custom_get_value() to return
	  when the input parameter is zero. (Otherwise the function returns the
	  input parameter value.)
```

## lib/logging/Kconfig
```kconfig
# Copyright (c) 2021, Legrand North America, LLC.
# SPDX-License-Identifier: Apache-2.0

config SYNCHROFLY_LOG_TWR_JSON
	bool "Print TWR/ranging JSON messages via printk"
	default y
	help
	  When enabled, ranging results are printed as JSON messages
	  over the debug channel (RTT/UART). Disable to suppress
	  these messages and reduce output bandwidth.
```
